## pcbs/gos_sensor_node/firmware/dts/bindings/semtech,sx1262.yaml
```yaml
description: Semtech SX1262 LoRa Transceiver
compatible: "semtech,sx1262"
include: [spi-device.yaml]
properties:
  spi-max-frequency:
    type: int
    default: 8000000
    description: SPI max frequency in Hz
  nss-gpios:
    type: phandle-array
    required: true
    description: NSS (Chip Select) GPIO
  busy-gpios:
    type: phandle-array
    required: true
    description: BUSY pin
  dio1-gpios:
    type: phandle-array
    required: true
    description: DIO1 interrupt
  dio2-gpios:
    type: phandle-array
    description: DIO2 GPIO
  dio3-gpios:
    type: phandle-array
    description: DIO3 GPIO
  nreset-gpios:
    type: phandle-array
    required: true
    description: Reset GPIO
  frequency:
    type: int
    required: true
    description: RF frequency in Hz
  spreading-factor:
    type: int
    required: true
    description: Spreading factor (7-12)
  bandwidth:
    type: int
    required: true
    description: Bandwidth in Hz
  coding-rate:
    type: int
    required: true
    description: Coding rate (1=4/5, 2=4/6, 3=4/7, 4=4/8)
  preamble-length:
    type: int
    default: 8
    description: Preamble length
  tx-power:
    type: int
    default: 22
    description: TX power in dBm
```

## pcbs/gos_sensor_node/firmware/dts/bindings/sensirion,sht4x.yaml
```yaml
description: Sensirion SHT4x Temperature/Humidity Sensor
compatible: "sensirion,sht4x"
include: [i2c-device.yaml]
properties:
  reg:
    type: int
    required: true
    description: I2C address
  status:
    type: string
    default: "okay"
    description: Device status
```

## pcbs/gos_sensor_node/firmware/dts/bindings/ti,bq24075.yaml
```yaml
description: Texas Instruments BQ24075 Battery Charger
compatible: "ti,bq24075"
include: [i2c-device.yaml]
properties:
  pg-gpios:
    type: phandle-array
    description: Power Good output
  stat-gpios:
    type: phandle-array
    description: Status output
  ce-gpios:
    type: phandle-array
    description: Charge Enable input
  ts-gpios:
    type: phandle-array
    description: Thermistor input
```

## pcbs/gos_sensor_node/firmware/dts/bindings/ti,tps62740.yaml
```yaml
description: Texas Instruments TPS62740 Buck Converter
compatible: "ti,tps62740"
include: [gpio-device.yaml]
properties:
  en-gpios:
    type: phandle-array
    required: true
    description: Enable pin
  vsel0-gpios:
    type: phandle-array
    required: true
    description: Voltage Select 0
  vsel1-gpios:
    type: phandle-array
    required: true
    description: Voltage Select 1
  pg-gpios:
    type: phandle-array
    required: true
    description: Power Good output
```
